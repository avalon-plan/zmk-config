## boards/shields/knob_macropad/Kconfig.defconfig
```kconfig
if SHIELD_KNOB_MACROPAD

config ZMK_KEYBOARD_NAME
    default "Knob Macropad"

endif
```

## config/west.yml
```yaml
manifest:
  remotes:
    - name: zmkfirmware
      url-base: https://github.com/zmkfirmware
    - name: adolto
      url-base: https://github.com/adolto
    - name: te9no
      url-base: https://github.com/te9no
  projects:
    - name: zmk
      remote: zmkfirmware
      revision: main
      import: app/west.yml
    - name: zmk-driver-ams-as5600
      remote: adolto
      revision: main
    - name: zmk-input-processor-keybind
      remote: te9no
      revision: main
  self:
    path: config
```
